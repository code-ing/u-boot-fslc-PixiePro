## board/pixiepro/Kconfig
```kconfig
if TARGET_PIXIEPRO

config SYS_BOARD
	default "pixiepro"

config SYS_SOC
	default "mx6"

config SYS_CONFIG_NAME
	default "pixiepro"

endif
```

## configs/pixiepro_defconfig
```kconfig
CONFIG_SYS_EXTRA_OPTIONS="IMX_CONFIG=board/pixiepro/imximage.cfg,MX6Q"
CONFIG_ARM=y
CONFIG_TARGET_PIXIEPRO=y
```

## configs/pixieprodl_defconfig
```kconfig
CONFIG_SYS_EXTRA_OPTIONS="IMX_CONFIG=board/pixiepro/pixieprodl.cfg,MX6DL"
CONFIG_ARM=y
CONFIG_TARGET_PIXIEPRO=y
```

## configs/pixieproq_defconfig
```kconfig
CONFIG_SYS_EXTRA_OPTIONS="IMX_CONFIG=board/pixiepro/pixieproq.cfg,MX6Q"
CONFIG_ARM=y
CONFIG_TARGET_PIXIEPRO=y
```
